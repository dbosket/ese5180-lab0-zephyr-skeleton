## CMakeLists.txt
```
cmake_minimum_required(VERSION 3.20.0)

find_package(Zephyr REQUIRED HINTS $ENV{ZEPHYR_BASE})
project(bme_unit_test)

target_sources(app PRIVATE
    src/bme_test.c
)

target_include_directories(app PRIVATE
    ../..//bme5180
)
```

## prj.conf
```kconfig
CONFIG_ZTEST=y
CONFIG_ZTEST_ASSERT_VERBOSE=2
CONFIG_LOG=y
CONFIG_CBPRINTF_FP_SUPPORT=y
```

## src/bme_test.c
```c
#include <zephyr/ztest.h>
#include "bme.h"

ZTEST(bme_test_suite, test_known_vals)
{
    bme280_cal_data cal = {
        .dig_t1 = 28478,
        .dig_t2 = 26952,
        .dig_t3 = 50
    };

    int32_t raw_temp = 519360;
    int32_t result = bme280_cal(raw_temp, &cal);
    zassert_equal(result, 2047,
                  "Expected 20.47 C, got %d", result);
}

ZTEST(bme_test_suite, test_zero_input)
{
    bme280_cal_data cal = {
        .dig_t1 = 28478,
        .dig_t2 = 26952,
        .dig_t3 = 50
    };

    int32_t result = bme280_cal(0, &cal);
    zassert_true(result < 0,
                 "Expected a low temp");
}

ZTEST(bme_test_suite, test_temperature_increases_with_raw_value)
{
    bme280_cal_data cal = {
        .dig_t1 = 28478,
        .dig_t2 = 26952,
        .dig_t3 = 50
    };

    int32_t temp1 = bme280_cal(519328, &cal);
    int32_t temp2 = bme280_cal(519460, &cal);

    zassert_true(temp2 >= temp1,
                 "Expected higher raw val to give higher temp val");
}

ZTEST_SUITE(bme_test_suite, NULL, NULL, NULL, NULL, NULL);
```
