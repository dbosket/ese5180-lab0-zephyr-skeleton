## lab0/tests/SUM_UNIT_TEST/testcase.yaml
```yaml
tests:
 sum_log.test:
   platform_allow: qemu_cortex_m3     # comment out 'platform_allow' and run twister without -p flag to auto-select available boards
   tags:
      - sum_log
      - unit
   harness: ztest
```
